## boards/shields/lobo/Kconfig.shield
```kconfig
# Copyright (c) 2025 James Crosswell
# SPDX-License-Identifier: MIT

config SHIELD_LOBO_LEFT
    def_bool $(shields_list_contains,lobo_left)

config SHIELD_LOBO_RIGHT
    def_bool $(shields_list_contains,lobo_right)
```
